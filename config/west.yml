## config/west.yml
```yaml
manifest:
  remotes:
    - name: zmkfirmware
      url-base: https://github.com/zmkfirmware
    - name: sensor-test
      url-base: https://github.com/nickconway
  projects:
    - name: zmk
      remote: sensor-test
      revision: generic-encoder-bind
      import: app/west.yml
  self:
    path: config
```
